## app/Kconfig
```kconfig
config ZMK_BEHAVIOUR_OS_LAYER
    bool "OS Layer switching"
    default n

config ZMK_INPUT_PROCESSOR_SCROLL_ACCELERATION
    bool "Enable scroll acceleration input processor"
    default y
    depends on ZMK_POINTING
```

## config/west.yml
```yaml
manifest:
  remotes:
    - name: zmkfirmware
      url-base: https://github.com/zmkfirmware
    - name: yamaryu211
      url-base: https://github.com/yamaryu211
    - name: caksoylar
      url-base: https://github.com/caksoylar
    - name: badjeff
      url-base: https://github.com/badjeff
    - name: te9no
      url-base: https://github.com/te9no
    - name: kot149
      url-base: https://github.com/kot149
    - name: elpekenin
      url-base: https://github.com/elpekenin
  projects:
    - name: zmk
      remote: zmkfirmware
      revision: v0.3
      import: app/west.yml
    - name: zmk-pmw3610-driver
      remote: badjeff
      revision: zmk-0.3
    - name: zmk-rgbled-widget
      remote: caksoylar
      revision: main
    - name: zmk-scroll-snap
      remote: kot149
      revision: v1
    - name: zmk-input-processor-keybind
      remote: te9no
      revision: main
    - name: zmk-input-processor-report-rate-limit
      remote: badjeff
      revision: main
    - name: zmk-userspace
      remote: elpekenin
      revision: main

  self:
    path: config
```
