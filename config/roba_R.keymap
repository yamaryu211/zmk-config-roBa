#include "roBa_L.keymap"

#include "boards/shields/Test/roBa_R.overlay"
&trackball {
    automouse-layer = <AML>;
    scroll-layers = <FUNC_SCROLL_MAC FUNC_SCROLL_WIN>;
    // snipe-layers = <3>;

    // スクロールレイヤー
    /*
    roBa_R.overlayに以下を追記すると、レイヤー4ではカーソル移動がスクロールに変換される。 
    自分の試したところ、y方向のスクロールが逆になったので&zip_xy_transformで反転させている。 
    スクロール量が多すぎるor少なすぎる場合は、&zip_xy_scalerの部分をコメント解除して調整できる。
    <&zip_xy_scaler X Y> X: X軸（水平方向）のスケーリング係数, : Y軸（垂直方向）のスケーリング係数
    */
    arrows {
        layers = <NUM_MAC NUM_WIN>;
        bindings =
            <&kp RIGHT_ARROW>,
            <&kp LEFT_ARROW>,
            <&kp UP_ARROW>,
            <&kp DOWN_ARROW>;

        tick = <10>;
        wait-ms = <5>;
        tap-ms = <5>;
    };

    volume {
        layers = <SYMBOL_MAC SYMBOL_WIN>;
        bindings =
                <&none>,
                <&none>,
                <&kp C_VOLUME_UP>,
                <&kp C_VOLUME_DOWN>;

        wait-ms = <5>;
        tap-ms = <5>;
    };
};